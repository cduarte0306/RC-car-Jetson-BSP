/dts-v1/;
/plugin/;

/ {
    compatible = "nvidia,p3768-0000+p3767-0005", "nvidia,tegra234";

    fragment@0 {
        target = <&spi1>;
        __overlay__ {
            /* 
             * Re-parent SPI1 to a slower PLLP clock source
             * so user space can request <3 MHz SPI speeds.
             */
            assigned-clocks = <&tegra_car TEGRA234_CLK_SPI1>;
            assigned-clock-parents = <&tegra_car TEGRA234_CLK_PLLP_OUT0>;
            assigned-clock-rates = <12000000>; /* 12 MHz parent clock */
        };
    };
};
