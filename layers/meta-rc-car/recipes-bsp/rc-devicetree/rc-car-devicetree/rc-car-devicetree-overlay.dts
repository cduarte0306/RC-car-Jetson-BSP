/dts-v1/;
/plugin/;


/ {
    compatible = "nvidia,p3768-0000+p3767-0005", "nvidia,tegra234";

    fragment@0 {
        target-path = <&spi1>;
        __overlay__ {
            /* Re-parent SPI1 clock for lower achievable bus frequencies */
            assigned-clocks = <&tegra_car 135>;
            assigned-clock-parents = <&tegra_car 102>;
            assigned-clock-rates = <12000000>; /* 12 MHz parent */
        };
    };
};
